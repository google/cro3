/*
 * Copyright (c) 2011 The Chromium OS Authors. All rights reserved.
 * Use of this source code is governed by a BSD-style license that can be
 * found in the LICENSE file.
 */

/*
 * This file holds Chrome OS-specific options, kept within a chromeos-config
 */

/ {
	chromeos-config {
		twostop;                /* Two-stop boot */
		twostop-optional;       /* One-stop optimization enabled */
		textbase = <0xe08000>;  /* Address where U-Boot loads */

		/*
		 * Device and offset for second-stage firmware, in SPI for now
		 * second-stage = <&emmc 0x00000080 0>;
		 */

		/* Memory addresses for kernel, cros-system and gbb */
		kernel = <0x00100000 0x00800000>;
		cros-system-data = <0x00900000 0x8000>;
		google-binary-block = <0x00908000 0x80000>;
	};

	config {
		silent_console = <0>;
	};

	chosen {
		bootargs = "";
	};

};
